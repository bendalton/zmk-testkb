## config/boards/arm/testkb/Kconfig.board
```kconfig
#
# Copyright (c) 2021 Polarity Works
# SPDX-License-Identifier: MIT
#

config BOARD_testkb_LEFT
	bool "testkb_left"
	depends on SOC_NRF52840_QIAA

config BOARD_testkb_RIGHT
	bool "testkb_right"
	depends on SOC_NRF52840_QIAA
```

## config/boards/arm/testkb/Kconfig.defconfig
```kconfig
#
# Copyright (c) 2021 Polarity Works
# SPDX-License-Identifier: MIT
#

if BOARD_testkb_LEFT

	config ZMK_KEYBOARD_NAME
	default "testkb"

endif # BOARD_testkb_LEFT

if BOARD_testkb_RIGHT

	config ZMK_KEYBOARD_NAME
	default "testkb rt"

endif # BOARD_testkb_RIGHT


if BOARD_testkb_LEFT || BOARD_testkb_RIGHT

config BOARD
	default "testkb"

config ZMK_SPLIT
	default y

config SPI
    bool
    default y

config BT_CTLR
	default BT

config ZMK_BLE
	default y

config ZMK_USB
	default y

if USB

config USB_NRFX
	default y

config USB_DEVICE_STACK
	default y

endif # USB



config SPI
	default y



endif # BOARD_testkb_LEFT || BOARD_testkb_RIGHT
```
